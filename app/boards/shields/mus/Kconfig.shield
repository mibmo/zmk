## app/boards/shields/mus/Kconfig.shield
```kconfig
# Copyright (c) 2020 Pete Johanson
# SPDX-License-Identifier: MIT

config SHIELD_MUS
    bool

config SHIELD_MUS_LEFT
	def_bool $(shields_list_contains,mus_left)
	select SHIELD_MUS

config SHIELD_MUS_RIGHT
	def_bool $(shields_list_contains,mus_right)
	select SHIELD_MUS
```
